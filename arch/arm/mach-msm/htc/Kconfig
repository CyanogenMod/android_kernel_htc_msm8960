## drivers/media/video/msm/Kconfig
```kconfig
config MSM_CAMERA_V4L2
        bool "MSM Camera V4L2 Interface"
        depends on MSM_CAMERA
        default n
        ---help---
          This flag enables V4L2 interface of MSM
          camera driver. If enabled, application interacts
          with /dev/video0 through V4L2 APIs. Otherwise,
          native APIs are used through /dev/config0, /dev/frame0,
          and /dev/control0.

comment "Camera Sensor Selection"
config MT9T013
	bool "Sensor mt9t013 (BAYER 3M)"
	depends on MSM_CAMERA && !ARCH_MSM8X60 && !ARCH_MSM8960 && !MSM_CAMERA_V4L2
	default y
	---help---
	  MICRON 3M Bayer Sensor with AutoFocus
config MT9D113
	bool "Sensor mt9d113 (YUV 2M)"
	depends on MSM_CAMERA && ARCH_MSM8X60 && !MSM_CAMERA_V4L2
	default y
	---help---
	  MICRON 2M YUV Sensor
	  This sensor is the front camera on QT8660.
	  This uses csi mipi interface.
	  This sensor is used only on QT device.
config MT9D112
	bool "Sensor mt9d112 (YUV 2M)"
	depends on MSM_CAMERA && !ARCH_MSM8X60 && !ARCH_MSM8960 && !MSM_CAMERA_V4L2
	default y
	---help---
	  MICRON 2M YUV Sensor
config IMX074
	bool "Sensor IMX074 (BAYER 13.5M)"
	depends on MSM_CAMERA
	---help---
	SONY 13.5 MP Bayer Sensor

config S5K3H2YX
	bool "Sensor s5k3h2yx (Samsung 8M)"
	depends on MSM_CAMERA
	default n
	---help---
	  Support for S5K3H2YX samsung sensor driver.
	  It is a Bayer 8MP sensor with auto focus and it supports
	  two mipi lanes.

config S5K6A1GX
	bool "Sensor s5k6a1gx (Samsung 1.3M)"
	depends on MSM_CAMERA
	default n
	---help---
	  Support for S5K6A1GX samsung sensor driver.
	  It is a Bayer 1.3MP sensor it supports one mipi lanes.

config AR0260
	bool "Sensor ar0260"
	depends on MSM_CAMERA
	default n
	---help---
	  Support for AR0260 sensor driver.

config OV2722
	bool "Sensor ov2722"
	depends on MSM_CAMERA
	default n
	---help---
	  Support for OV2722 sensor driver.

config OV5640
	bool "Sensor OV5640 (YUV 5M)"
	depends on MSM_CAMERA && !MSM_CAMERA_V4L2
	default n
	---help---
	Omni 5M YUV Sensor

config OV5647
	bool "Sensor ov5647 (BAYER 5M)"
	depends on MSM_CAMERA
	---help---
	  OV 5M Bayer Sensor with AutoFocus

config AD5046_ACT
	bool "Lens actuator ad5046"
	depends on MSM_CAMERA && OV5647
	---help---
	  ad5046 lens actuator driver for ov5647.
	  Say Y here if this is msm7627A variant platform.
config WEBCAM_OV7692_QRD
	bool "Sensor OV7692 QRD(VGA YUV)"
	depends on MSM_CAMERA && ARCH_MSM7X27A
	default n
	---help---
	  Omni Vision VGA YUV Sensor for QRD Devices
config MT9M114
        bool "Sensor MT9M114 (YUV 1.26M)"
        depends on MSM_CAMERA
        ---help---
        APTINA 1.26 MP yuv Sensor
config WEBCAM_OV7692
	bool "Sensor OV7692 (VGA YUV)"
	depends on MSM_CAMERA && ARCH_MSM8X60 && !MSM_CAMERA_V4L2
	default y
	---help---
	  Omni Vision VGA YUV Sensor.
config WEBCAM_OV9726
	bool "Sensor OV9726 (VGA Bayer)"
	depends on MSM_CAMERA && (ARCH_MSM8X60 || ARCH_MSM7X30 || ARCH_MSM7X27A)
	default n
	---help---
	  Omni Vision VGA Bayer Sensor.
#	This Senosr is used as a webcam.
#	This uses the CSI interface.
config VX6953
	bool "Sensor VX6953 (BAYER 5M)"
	depends on MSM_CAMERA && (ARCH_MSM7X30 || ARCH_MSM8X60)
	default n
	---help---
	STM 5M Bayer Sensor with EDOF
config SN12M0PZ
	bool "Sensor sn12m0pz (Bayer 12 MP)"
	depends on MSM_CAMERA && ARCH_MSM7X30 && !MSM_CAMERA_V4L2
	default y
	---help---
	  Sony 12 MP Bayer Sensor
config MT9P012
	bool "Sensor mt9p012 (BAYER 5M)"
	depends on MSM_CAMERA && !ARCH_MSM8X60 && !MSM_CAMERA_V4L2
	default y
	---help---
	  MICRON 5M Bayer Sensor with Autofocus

choice
	prompt "AF module"
	depends on MT9P012 && !ARCH_MSM8X60 && !MSM_CAMERA_V4L2
	default MSM_CAMERA_AF_FOXCONN

config MSM_CAMERA_AF_FOXCONN
	bool "FOXCONN Module"
	help
	  This driver supports FOXCONN AF module for 5M Bayer sensor

config MSM_CAMERA_AF_BAM
	bool "BAM Module"
	help
	  This driver supports BAM AF module for 5M Bayer sensor

endchoice

config MT9P012_KM
	bool "Sensor mt9p012 KM module (BAYER 5M)"
	depends on MSM_CAMERA && !ARCH_MSM8X60 && !MSM_CAMERA_V4L2
	default y
	---help---
	  MICRON 5M Bayer Sensor KM modules with Autofocus

config MT9E013
	bool "Sensor mt9e013 module (BAYER 8M)"
	depends on MSM_CAMERA && (ARCH_MSM7X30 || ARCH_MSM8X60 || ARCH_MSM7X27A)
	default n
	---help---
	  Aptina 8M Bayer Sensor modules with Autofocus

config IMX074_ACT
	bool "Actuator IMX074 (BAYER 13.5M)"
	depends on MSM_CAMERA
	---help---
	Actuator for SONY 13.5 MP Bayer Sensor

config S5K3H2YX_ACT
	bool "Sensor s5k3h2yx actuator"
	depends on MSM_CAMERA
	default n
	---help---
	  Autofocus of s5k3h2yx actuator

config S5K3E2FX
	bool "Sensor s5k3e2fx (Samsung 5M)"
	depends on MSM_CAMERA && !ARCH_MSM8X60 && !MSM_CAMERA_V4L2
	default y
	---help---
	  Samsung 5M with Autofocus

config QS_S5K4E1
	bool "Sensor qs_s5k4e1 (Samsung 5M)"
	depends on MSM_CAMERA && ARCH_MSM8X60 && !MSM_CAMERA_V4L2
	default y
	---help---
	  Samsung 5M with Autofocus

config S5K4E1
	bool "Sensor Sensor s5k4e1 (Samsung 5M)"
	depends on MSM_CAMERA
	default n
	---help---
	  Support for S5k4E1 samsung sensor driver.
	  It is a Bayer 5MP sensor with auto focus and it supports
	  two mipi lanes, required for msm7x2xA platform.
	  Say Y here if this is msm7x2xA variant platform.

config DW9712_ACT
	bool "Lens actuator dw9721"
	depends on MSM_CAMERA && S5K4E1
	---help---
	  dw9721 lens actuator driver for S5K4E1.
	  Say Y here if this is msm7627A variant platform.

config MSM_CAMERA_FLASH_SC628A
	bool "Qualcomm MSM camera sc628a flash support"
	depends on MSM_CAMERA
	default n
	---help---
	  Enable support for LED flash for msm camera.
	  It is a samtech charge pump flash driver and it
	  supports spotlight and flash light modes with
	  differrent current levels.

config IMX072
	bool "Sensor imx072 (Sony 5M)"
	default n
	---help---
	  Support for IMX072 sony sensor driver.
	  It is a Bayer 5MP sensor with auto focus and it supports
	  two mipi lanes, required for msm7x2xA platform.
	  Say Y here if this is msm7x2xA variant platform.

config OV2720
	bool "Sensor ov2720 (Omnivision 2MP)"
	depends on MSM_CAMERA

config VB6801
	bool "Sensor vb6801"
	depends on MSM_CAMERA && !ARCH_MSM8X60 && !MSM_CAMERA_V4L2
	---help---
	  5M with flash

config MSM_CAMERA_FLASH
	bool "Qualcomm MSM camera flash support"
	depends on MSM_CAMERA
	default y
	---help---
	  Enable support for LED flash for msm camera

config MSM_CAMERA_SENSOR
	bool "Qualcomm MSM camera sensor support"
	depends on MSM_CAMERA

config MSM_ACTUATOR
	bool "Qualcomm MSM actuator support"
	depends on MSM_CAMERA

config MSM_GEMINI
	tristate "Qualcomm MSM Gemini Jpeg Engine support"
	depends on MSM_CAMERA && (ARCH_MSM7X30 || ARCH_MSM8X60 || ARCH_MSM8960)
	default n
	---help---
	  Enable support for Gemini Jpeg Engine

config MSM_VPE
	tristate "Qualcomm MSM Video Pre-processing Engine support"
	depends on MSM_CAMERA && (ARCH_MSM7X30 || ARCH_MSM8X60)
	default y
	---help---
	  Enable support for Video Pre-processing Engine

config RAWCHIP
	bool "Rawchip"
	depends on MSM_CAMERA
	default n
	---help---
	  ST Yushan rawchip

config RAWCHIPII
        bool "RawchipII"
        depends on MSM_CAMERA
        default n
        ---help---
          ST Yushan rawchipII

config CAMERA_IMAGE_NONE_BOARD
	bool "CameraImageNoneBoard"
	depends on MSM_CAMERA
	default n
	---help---
	  camera image none board

config QUP_EXCLUSIVE_TO_CAMERA
	bool "QUP exclusive to camera"
	depends on MSM_CAMERA
	default y
	---help---
	  This flag enabled states that QUP
	  is exclusive to camera. In case this
	  is disabled, the lvs1 voltage is enabled
	  by QUP in the board file as QUP is used by
	  applications other than camera.

config S5K3L1YX
	bool "Sensor S5K3L1YX (BAYER 12M)"
	depends on MSM_CAMERA
	---help---
		Samsung 12 MP Bayer Sensor with auto focus, uses
		4 mipi lanes, preview config = 1984 * 1508 at 30 fps,
		snapshot config = 4000 * 3000 at 20 fps,
		hfr video at 60, 90 and 120 fps.

config IMX091
	bool "Sensor IMX091 (BAYER 13M)"
	depends on MSM_CAMERA
	---help---
	SONY 13 MP Bayer Sensor

config IMX175
	bool "Sensor IMX175 (BAYER 8M)"
	depends on MSM_CAMERA
	---help---
	SONY 8 MP Bayer Sensor

config IMX135
	bool "Sensor IMX135 (BAYER 13M)"
	depends on MSM_CAMERA
	---help---
	SONY 13 MP Bayer Sensor

config OV8838
	bool "Sensor OV8838 (OmniVision 8M)"
	depends on MSM_CAMERA
	default n
	---help---
	  Support for OV8838 OmniVision sensor driver.
	  It is a Bayer 8MP sensor with auto focus and it supports
	  four mipi lanes and BSI.

config IMX175_ACT
	bool "Sensor imx175 actuator"
	depends on MSM_CAMERA
	default n
	---help---
	  Autofocus of imx175 actuator

config RUMBAS_ACT
	bool "RUMBA-S actuator"
	depends on MSM_CAMERA
	default n
	---help---
	  Autofocus of RUMBA-S actuator

config AD5823_ACT
       bool "Lens actuator ad5823"
       depends on MSM_CAMERA
       ---help---
         ad5823 lens actuator driver for SONY IMX175 and IMX091.

config AD5816_ACT
       bool "Lens actuator ad5816"
       depends on MSM_CAMERA
       ---help---
         ad5816 lens actuator driver for SONY IMX175 and IMX091.

config TI201_ACT
       bool "Lens actuator ti201"
       depends on MSM_CAMERA
       ---help---
         ti201 lens actuator driver for SONY IMX175, IMX091 and VD6869.

config ACT_OIS_BINDER
       bool "Act_Ois_Binder"
       depends on MSM_CAMERA
       default n
       ---help---
         Act_Ois_Binder for OIS function through ti201 lens actuator driver.

config LC898212_ACT
       bool "Lens actuator lc898212"
       depends on MSM_CAMERA
       default n
       ---help---
         lc898212 lens actuator driver for VD6869.

config MT9V113
	bool "Sensor mt9v113 (VGA YUV)"
	depends on MSM_CAMERA
	default n
	---help---
	  Support for MT9V113 Micron sensor driver.
	  It is a Bayer 0.3MP sensor it supports two mipi lanes.

config IMX175_2LANE
	bool "Sensor IMX175 2-Lane(BAYER 8M)"
	depends on MSM_CAMERA
	---help---
	SONY 8 MP Bayer Sensor for 2-lane hardware

config OV5693_ACT
	bool "Sensor OV5693 actuator"
	depends on MSM_CAMERA
	default n
	---help---
	  Autofocus of ov5693 actuator

config OV5693
	bool "Sensor ov5693 (BAYER 5M)"
	depends on MSM_CAMERA
	default n
	---help---
	  OV 5M Bayer Sensor with AutoFocus

config RAWCHIP_MCLK
	bool "Rawchip MCLK"
	depends on MSM_CAMERA
	default n
	---help---
	  ST Yushan rawchip MCLK

config DISABLE_MCLK_RAWCHIP_TO_MAINCAM
	bool "DISABLE MCLK FROM RAWCHIP TO MAINCAM"
	depends on MSM_CAMERA
	default n
	---help---
	  For the design for K2 two MCLK control of rawchip

config S5K6A2YA
	bool "Sensor s5k6a2ya (Samsung 1.6M)"
	depends on MSM_CAMERA
	default n
	---help---
	  Support for S5K6A2YA samsung sensor driver.
	  It is a Bayer 1.6MP sensor it supports one mipi lanes.

config S5K6AAFX
	bool "Sensor s5k6aafx (Samsung 1.3M)"
	depends on MSM_CAMERA
	default n
	---help---
	  Samsung 1.3M without Autofocus

config VD6869
	bool "Sensor VD6869 (BAYER 4M)"
	depends on MSM_CAMERA
	default n
	---help---
	ST 4MP Bayer Sensor

config OV4688
	bool "Sensor ov4688 (BAYER 4M)"
	depends on MSM_CAMERA
	default n
	---help---
	ov 4MP Bayer Sensor
```

## drivers/misc/fpr/Kconfig
```kconfig
#
# TI's shared transport line discipline and the protocol
# drivers (BT, FM and GPS)
#
menu "Vadality finger printer SPI driver"
config FPR_SPI
	bool "SPI driver for fingerprint"
    default n
	help
         SPI driver for finger print
config FPR_SPI_DMA_GSBI1
	bool "Enable GSBI1 SPI DMA for fingerprint"
    default n
	help
         Enable GSBI1 SPI DMA for fingerprint
config FPR_SPI_DMA_GSBI5
	bool "Enable GSBI5 SPI DMA for fingerprint"
    default n
	help
         Enable GSBI5 SPI DMA for fingerprint
endmenu
```

## drivers/net/wireless/bcmdhd_4330/Kconfig
```kconfig
config BCMDHD_4330
	tristate "Broadcom 4329/30 wireless cards support"
	depends on MMC
	---help---
	  This module adds support for wireless adapters based on
	  Broadcom 4329/30 chipset.

	  This driver uses the kernel's wireless extensions subsystem.

	  If you choose to build a module, it'll be called dhd. Say M if
	  unsure.

config BCMDHD_FW_PATH
	depends on BCMDHD_4330
	string "Firmware path"
	default "/system/etc/firmware/fw_bcm4330.bin"
	---help---
	  Path to the firmware file.

config BCMDHD_NVRAM_PATH
	depends on BCMDHD_4330
	string "NVRAM path"
	default "/etc/calibration"
	---help---
	  Path to the calibration file.

config BCMDHD_WEXT
	bool "Enable WEXT support"
	depends on BCMDHD_4330 && CFG80211 = n
	select WIRELESS_EXT
	select WEXT_PRIV
	help
	  Enables WEXT support

config HTC_IGNORE_SKB_ALIGNMENT
    tristate "HTC ignore skb 32bytes aligment to avoid CMD53 fragment"
    help
	  Enables HTC_IGNORE_SKB_ALIGNMENT support, for QCT platform, please enable this to avoid TP drop by SDIO CMD53 fragment.
```

## drivers/net/wireless/bcmdhd_4334_mcc/Kconfig
```kconfig
config BCMDHD_4334_MCC
	tristate "Broadcom 4329/30 wireless cards support"
	depends on MMC
	---help---
	  This module adds support for wireless adapters based on
	  Broadcom 4329/30 chipset.

	  This driver uses the kernel's wireless extensions subsystem.

	  If you choose to build a module, it'll be called dhd. Say M if
	  unsure.

config BCMDHD_FW_PATH
	depends on BCMDHD_4334_MCC
	string "Firmware path"
	default "/system/etc/firmware/fw_bcm4334.bin"
	---help---
	  Path to the firmware file.

config BCMDHD_NVRAM_PATH
	depends on BCMDHD_4334_MCC
	string "NVRAM path"
	default "/proc/calibration"
	---help---
	  Path to the calibration file.

config BCMDHD_WEXT
	bool "Enable WEXT support"
	depends on BCMDHD_4334_MCC && CFG80211 = n
	select WIRELESS_EXT
	select WEXT_PRIV
	help
	  Enables WEXT support

config HTC_IGNORE_SKB_ALIGNMENT
    tristate "HTC ignore skb 32bytes aligment to avoid CMD53 fragment"
    help
	  Enables HTC_IGNORE_SKB_ALIGNMENT support, for QCT platform, please enable this to avoid TP drop by SDIO CMD53 fragment.
```

## drivers/video/msm/sii9234/Kconfig
```kconfig
#
# Miscellaneous I2C chip drivers configuration
#
# *** DEPRECATED! Do not add new entries! See Makefile ***
#

menu "Miscellaneous I2C Chip support II"

config FB_MSM_HDMI_MHL
	depends on FB_MSM_HDMI_MSM_PANEL
	bool "MHL"
	default n
	---help---
	  Support for HDMI output through MHL

config FB_MSM_HDMI_MHL_SII9234
	depends on FB_MSM_HDMI_MHL
	bool "MHL SII9234"
	default n
	---help---
	  Support for HDMI output through MHL SiI9234
	  MHL SII9234 Driver implemented by HTC.

config FB_MSM_HDMI_MHL_SUPERDEMO
       depends on FB_MSM_HDMI_MHL_SII9234
       bool "MHL SUPERDEMO"
       default n
       ---help---
         Support for SCRATCHPAD event output through MHL SiI9234

config INTERNAL_CHARGING_SUPPORT
        depends on FB_MSM_HDMI_MHL_SII9234
        boolean "INTERNAL CHARGING SUPPORT"
        default n

endmenu
```
