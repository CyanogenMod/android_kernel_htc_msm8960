## arch/arm/mach-msm/htc/Kconfig
```kconfig
config MACH_HTC
	bool
	select FB_MSM_MIPI_DSI

menu "HTC Board Selection"
source "arch/arm/mach-msm/htc/Kconfig.board"
endmenu


menu "HTC Specific Patches"

config HTC_BATT_ALARM
	bool "Enable 3.0V device shutdown mechanism"
	depends on HAS_EARLYSUSPEND
	default n
	help
	  Enable 3.0V triggeer level 0 shutdown rule

config HTC_BATT_CORE
	depends on POWER_SUPPLY
	default n
	bool "HTC battery core driver"

config HTC_BATT_8960
	depends on HTC_BATT_CORE
	default n
	bool "HTC battery driver for MSM8960"

config HTC_HEADSET_MGR
	tristate "HTC headset manager driver"
	default n
	help
	  Provides support for HTC headset manager.

config HTC_HEADSET_PMIC
	tristate "HTC PMIC headset detection driver"
	depends on HTC_HEADSET_MGR
	default n
	help
	  Provides support for HTC PMIC headset detection.

config HTC_HEADSET_ONE_WIRE
	tristate "HTC 1-wire headset detection driver"
	depends on HTC_HEADSET_MGR
	default n
	help
	  Provides support for HTC 1-wire headset detection.

config HTC_WAKE_ON_VOL
	bool "Enable wake-on-volume support"
	default y

config HTC_HEADSET_GPIO
	tristate "HTC GPIO headset detection driver"
	depends on HTC_HEADSET_MGR
	default n
	help
	  Provides support for HTC GPIO headset detection.

endmenu
```

## arch/arm/mach-msm/htc/Kconfig.board
```kconfig
#
# Include the specific Kconfig file for HTC board
#

# ELITE
source "arch/arm/mach-msm/htc/elite/Kconfig"

# FIGHTER
source "arch/arm/mach-msm/htc/fighter/Kconfig"

# JET
source "arch/arm/mach-msm/htc/jet/Kconfig"

# VILLE
source "arch/arm/mach-msm/htc/ville/Kconfig"

# M7
source "arch/arm/mach-msm/htc/m7/Kconfig"

# T6
source "arch/arm/mach-msm/htc/t6/Kconfig"

# M4
source "arch/arm/mach-msm/htc/m4/Kconfig"

# ZARA
source "arch/arm/mach-msm/htc/zara/Kconfig"

config MACH_HTC_DUMMY
	bool "NONE (No device)"
```

## arch/arm/mach-msm/htc/elite/Kconfig
```kconfig
config BOARD_HEADER_FILE
	string "HTC board specific header file name"
	default ""

config MACH_ELITE
	depends on ARCH_MSM8960
	select MACH_HTC
	bool "HTC Elite"
	help
	  Support for the HTC ELITE device.
```

## arch/arm/mach-msm/htc/fighter/Kconfig
```kconfig
config BOARD_HEADER_FILE
	string "HTC board specific header file name"
	default ""

config MACH_FIGHTER
	depends on ARCH_MSM8960
	select MACH_HTC
	bool "HTC FIGHTER"
	help
	  Support for the HTC FIGHTER device.
```

## arch/arm/mach-msm/htc/jet/Kconfig
```kconfig
config BOARD_HEADER_FILE
	string "HTC board specific header file name"
	default ""

config MACH_JET
	depends on ARCH_MSM8960
	select MACH_HTC
	bool "HTC JET"
	help
	  Support for the HTC JET device.
```

## arch/arm/mach-msm/htc/m4/Kconfig
```kconfig
config BOARD_HEADER_FILE
	string "HTC board specific header file name"
	default ""

config MACH_M4_UL
	depends on ARCH_MSM8930
	select MACH_HTC
	bool "HTC M4_UL"
	help
	  Support for the HTC M4_UL device.
```

## arch/arm/mach-msm/htc/m7/Kconfig
```kconfig
config BOARD_HEADER_FILE
	string "HTC board specific header file name"
	default ""

config MACH_M7_UL
	depends on ARCH_APQ8064
	select MACH_HTC
	bool "HTC One"
	help
	  Support for the HTC M7 device.

config CABC_DIMMING_SWITCH
	depends on MACH_M7_UL
	bool "Enable panel CABC dimming switch"
	default y
	help
	  Enable CABC dimming switch.

config SRE_CONTROL
	depends on MACH_M7_UL
	bool "Enable panel SRE control"
	default y
	help
	  Enable SRE control.
```

## arch/arm/mach-msm/htc/t6/Kconfig
```kconfig
config BOARD_HEADER_FILE
	string "HTC board specific header file name"
	default ""

config MACH_T6_UL
	depends on ARCH_APQ8064
	select MACH_HTC
	bool "HTC One"
	help
	  Support for the HTC T6 device.

config CABC_DIMMING_SWITCH
	depends on MACH_T6_UL
	bool "Enable panel CABC dimming switch"
	default y
	help
	  Enable CABC dimming switch.

config SRE_CONTROL
	depends on MACH_T6_UL
	bool "Enable panel SRE control"
	default y
	help
	  Enable SRE control.
```

## arch/arm/mach-msm/htc/ville/Kconfig
```kconfig
config BOARD_HEADER_FILE
	string "HTC board specific header file name"
	default ""

config MACH_VILLE
	depends on ARCH_MSM8960
	select MACH_HTC
	bool "HTC Ville"
	help
	  Support for the HTC VILLE device.
```

## arch/arm/mach-msm/htc/zara/Kconfig
```kconfig
config BOARD_HEADER_FILE
	string "HTC board specific header file name"
	default ""

config MACH_ZARA
	depends on ARCH_MSM8930
	select MACH_HTC
	bool "ZARA"
	help
	  Support for the HTC ZARA

config CABC_DIMMING_SWITCH
	depends on MACH_ZARA
	bool "Enable panel CABC dimming switch"
	default y
	help
	   Enable CABC dimming switch.
```

## drivers/felica/Kconfig
```kconfig
config FELICA_DD
	tristate "FELICA driver support"
	help
	  Say Y here if you want to support felica feature...
```

## drivers/gpu/Kconfig
```kconfig
# Added by HTC Display/Graphics for msm gpu driver

choice
      	prompt "Select MSM 3D Graphic driver branch"
	depends on FB_MSM
	default MSM_KGSL_MAINLINE if SYNC
	default MSM_KGSL_JB_REL_RB31

config MSM_KGSL_MAINLINE
        bool "MSM 3D Graphics driver (branch jb_2.5)"
        depends on FB_MSM
        help
          3D graphics driver for Adreno200. Required to
          use hardware accelerated OpenGL ES 2.0 and 1.1 on these
          chips.

config MSM_KGSL_JB_REL_RB31
        bool "MSM 3D Graphics driver (branch jb_rel_rb3.1)"
        depends on FB_MSM
        help
          3D graphics driver for Adreno205. Required to
          use hardware accelerated OpenGL ES 2.0 and 1.1 on these
          chips.
endchoice

if MSM_KGSL_MAINLINE
source "drivers/gpu/msm/Kconfig"
endif

if MSM_KGSL_JB_REL_RB31
source "drivers/gpu/msm_rb31/Kconfig"
endif
```

## drivers/htc_debug/stability/Kconfig
```kconfig
config DIRTY_SYSTEM_DETECTOR
        depends on ARCH_APQ8064 || ARCH_MSM8960 || ARCH_MSM8X60 || ARCH_QSD8X50 || ARCH_MSM7X30 || ARCH_MSM7X00A || ARCH_MSM7227 || ARCH_MSM7225
        default n
        bool "HTC dirty file detector for /system partition"

config HTC_PROCESS_DEBUG
        bool "process/thread debug support"
        default y
        help
	  This option enables kernel debug log to check if any
          assigned process receives signal or unexpected exit

config HTC_DEBUG_SAVE_BOOT_MSG
        default y
        bool "HTC debug: saving kernel log of booting to memory"

config HTC_DEBUG_REPORT_MEMINFO
        depends on SLUB && TRACING
        default y
        bool "HTC debug: Report memory usage which is not included in /proc/meminfo, such as kmalloc, dma, ftrace"
        help
          Enable this will get more memory report entries in /proc/meminfo
```
